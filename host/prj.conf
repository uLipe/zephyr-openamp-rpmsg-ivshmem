## prj.conf
```kconfig
CONFIG_PCIE=y
# required by doorbell
CONFIG_PCIE_MSI=y
CONFIG_PCIE_MSI_X=y
CONFIG_PCIE_MSI_MULTI_VECTOR=y
CONFIG_POLL=y

CONFIG_VIRTUALIZATION=y
CONFIG_IVSHMEM=y
CONFIG_IVSHMEM_DOORBELL=y

CONFIG_SHELL=y
# Enable IVSHMEM shell when debugging the driver, default OFF to supress warnings when not used.
CONFIG_IVSHMEM_SHELL=n
CONFIG_OPENAMP=y
# Comment this line when building to the slave instance
CONFIG_OPENAMP_SLAVE=n
```

## boards/qemu_cortex_a53.conf
```kconfig
CONFIG_PCIE_CONTROLLER=y
CONFIG_PCIE_ECAM=y

# Hungry PCI requires at least 256M of virtual space
CONFIG_KERNEL_VM_SIZE=0x80000000

# Hungry PCI requires phys addresses with more than 32 bits
CONFIG_ARM64_VA_BITS_40=y
CONFIG_ARM64_PA_BITS_40=y

# MSI support requires ITS
CONFIG_GIC_V3_ITS=y

# ITS, in turn, requires dynamic memory (9x64 + alignment constrains)
# Additionally, our test also uses malloc
CONFIG_HEAP_MEM_POOL_SIZE=1048576
```

## src/main.c
```c
/*
 * Copyright 2023 Linaro.
 *
 * SPDX-License-Identifier: BSD-3-Clause
 */

#include <zephyr/kernel.h>
#include <openamp/open_amp.h>
#include <zephyr/shell/shell.h>
#include <stdio.h>
#include "rpmsg_ivshmem_backend.h"

static struct rpmsg_endpoint ept;
struct rpmsg_device* rpmsg_dev = NULL;
static int number_of_completed_msgs = 0;
K_SEM_DEFINE(rx_sem, 0, 1);

int endpoint_cb(struct rpmsg_endpoint *ept, void *data,
		size_t len, uint32_t src, void *priv)
{

	number_of_completed_msgs++;

	printf("Remote side echoed the string back:\n");
	printf("[ %s ]\n", (const char *)data);
	printf("at message number %d \n\n",number_of_completed_msgs);

	k_sem_give(&rx_sem);
	return RPMSG_SUCCESS;
}

static void rpmsg_service_unbind(struct rpmsg_endpoint *ept)
{
}

void main (void)
{
	rpmsg_dev = get_rpmsg_ivshmem_device();

	if(!rpmsg_dev) {
		printf("Could not get the RPMsg device for IVSHMEM backend! \n");
		return;
	}

	/* Setup the endpoint, this will notify the host side and allow it
	 * to finish the RPMsg communication estabilishement.
	 */
	int status = rpmsg_create_ept(&ept, rpmsg_dev, "k", RPMSG_ADDR_ANY,
			get_rpmsg_ivshmem_ept_dest_addr(),
			endpoint_cb, rpmsg_service_unbind);
	if (status != 0) {
		printf("rpmsg_create_ept failed %d\n", status);
		return;
	}

	printf("Hello %s - Host Side, the communication over RPMsg is ready to use! \n", CONFIG_BOARD);
}

static int cmd_rpmsg_ivshmem_send(const struct shell *sh,
			   size_t argc, char **argv)
{
	char *str = argv[1];
	int noof_messages = strtol(argv[2], NULL, 10);

	if(!rpmsg_dev) {
		printf("RPMsg over IVSHMEM backend is not ready yet! \n");
		return -ENODEV;
	}

	number_of_completed_msgs = 0;

	do {
		int status = rpmsg_send(&ept, str, strlen(str) + 1);
		if(status < 0) {
			printf("failed to send message over RPMsg-IVSHMEM to the Remote side: %d \n", status);
			return status;
		}

		status = k_sem_take(&rx_sem, K_MSEC(5000));
		if(status) {
			printf("Remote side response timed out! \n");
			return status;
		}

		noof_messages--;

	} while (noof_messages);

	return 0;
}

SHELL_STATIC_SUBCMD_SET_CREATE(sub_rpmsg_ivshmem,
						SHELL_CMD_ARG(send, NULL,
								"Usage: rpmsg_ivshmem send <string> <number of messages>",
								cmd_rpmsg_ivshmem_send, 3, 0),
						SHELL_SUBCMD_SET_END
		);

SHELL_CMD_ARG_REGISTER(rpmsg_ivshmem, &sub_rpmsg_ivshmem,
		       "Commands to use RPMsg over IVSHMEM",
		       cmd_rpmsg_ivshmem_send, 3 , 0);
```
